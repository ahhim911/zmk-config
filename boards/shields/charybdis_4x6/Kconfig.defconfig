## boards/shields/charybdis_4x6/Kconfig.defconfig
```kconfig
if SHIELD_CHARYBDIS_RIGHT

config ZMK_KEYBOARD_NAME
	default "Charybdis"

config ZMK_SPLIT_BLE_ROLE_CENTRAL
	default y

endif

if SHIELD_CHARYBDIS_RIGHT
config ZMK_KEYBOARD_NAME
	default "Charybdis Right"
CONFIG_SPI=y
CONFIG_INPUT=y
CONFIG_ZMK_MOUSE=y
CONFIG_PMW3610=y
# CONFIG_PMW3610_SWAP_XY=y
# CONFIG_PMW3610_INVERT_X=y
# CONFIG_PMW3610_INVERT_Y=y
# CONFIG_PMW3610_REPORT_INTERVAL_MIN=12
# CONFIG_PMW3610_LOG_LEVEL_DBG=y
endif 

if SHIELD_CHARYBDIS_LEFT || SHIELD_CHARYBDIS_RIGHT

config ZMK_SPLIT
	default y
	
endif
```

## boards/shields/charybdis_4x6/Kconfig.shield
```kconfig
config SHIELD_CHARYBDIS_LEFT
	def_bool $(shields_list_contains,charybdis_4x6_left)

config SHIELD_CHARYBDIS_RIGHT
	def_bool $(shields_list_contains,charybdis_4x6_right)
```
